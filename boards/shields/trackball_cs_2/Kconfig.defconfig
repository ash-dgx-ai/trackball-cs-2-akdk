## boards/shields/trackball_cs_2/Kconfig.defconfig
```kconfig
if SHIELD_TRACKBALL_CS_2_RIGHT

config ZMK_KEYBOARD_NAME
    default "trackball_cs_2"

endif

if SHIELD_TRACKBALL_CS_2_LEFT || SHIELD_TRACKBALL_CS_2_RIGHT

config ZMK_SPLIT
    default y

endif
```

## boards/shields/trackball_cs_2/Kconfig.shield
```kconfig
config SHIELD_TRACKBALL_CS_2_LEFT
    def_bool $(shields_list_contains,trackball_cs_2_left)
config SHIELD_TRACKBALL_CS_2_RIGHT
    def_bool $(shields_list_contains,trackball_cs_2_right)
```
